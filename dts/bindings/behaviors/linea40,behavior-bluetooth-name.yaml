## dts/bindings/behaviors/linea40,behavior-bluetooth-name.yaml
```yaml
description: Select and persist this keyboard's Bluetooth device name
compatible: "linea40,behavior-bluetooth-name"
include: zero_param.yaml

properties:
  device-name:
    type: string
    required: true
    description: Bluetooth name to save on this keyboard when the binding is pressed
```

## dts/bindings/behaviors/linea40,behavior-profile-binding.yaml
```yaml
description: Select a Mac or Windows behavior using the active Bluetooth profile
compatible: "linea40,behavior-profile-binding"
include: zero_param.yaml

properties:
  windows-profile:
    type: int
    required: true
    description: Bluetooth profile that uses the second binding; all others use the first
  bindings:
    type: phandle-array
    required: true
    description: Exactly two behaviors, Mac first and Windows second
```

## dts/bindings/behaviors/linea40,behavior-profile-key.yaml
```yaml
description: Send an OS-specific key according to the selected Bluetooth profile
compatible: "linea40,behavior-profile-key"
include: zero_param.yaml

properties:
  windows-profile:
    type: int
    required: true
    description: Bluetooth profile that uses windows-keycode; all others use mac-keycode
  mac-keycode:
    type: int
    required: true
    description: Encoded ZMK keycode for Mac, including any implicit modifiers
  windows-keycode:
    type: int
    required: true
    description: Encoded ZMK keycode for Windows, including any implicit modifiers
```
